## test/connectivity/sdkconfig.defaults
```kconfig
CONFIG_ESP_SYSTEM_PANIC_PRINT_HALT=y
CONFIG_ESP_MAIN_TASK_STACK_SIZE=16384
CONFIG_ESP_WIFI_GMAC_SUPPORT=n
CONFIG_FREERTOS_UNICORE=y
CONFIG_FREERTOS_IDLE_TASK_STACKSIZE=4096
CONFIG_HEAP_POISONING_COMPREHENSIVE=y
CONFIG_PTHREAD_TASK_STACK_SIZE_DEFAULT=32768
CONFIG_PTHREAD_STACK_MIN=4096
```
